#include "kommanddeck.dtsi"

/ {
    chosen {
        zmk,kscan = &kscan0;
        zmk,matrix_transform = &default_transform;
    };
};

&kscan0 {
    col-gpios
        = <&gpio1 4  (GPIO_ACTIVE_HIGH)>   /* col 0  */
        , <&gpio1 6  (GPIO_ACTIVE_HIGH)>   /* col 1  */
        , <&gpio1 7  (GPIO_ACTIVE_HIGH)>   /* col 2  */
        , <&gpio0 9  (GPIO_ACTIVE_HIGH)>   /* col 3  */
        , <&gpio0 10 (GPIO_ACTIVE_HIGH)>   /* col 4  */
        , <&gpio1 11 (GPIO_ACTIVE_HIGH)>   /* col 5  */
        , <&gpio1 13 (GPIO_ACTIVE_HIGH)>   /* col 6  */
        , <&gpio1 15 (GPIO_ACTIVE_HIGH)>   /* col 7  */
        , <&gpio0 2  (GPIO_ACTIVE_HIGH)>   /* col 8  */
        , <&gpio0 29 (GPIO_ACTIVE_HIGH)>   /* col 9  */
        , <&gpio0 31 (GPIO_ACTIVE_HIGH)>   /* col 10 */
        ;
};
