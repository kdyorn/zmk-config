## config/boards/shields/kommanddeck/Kconfig.defconfig
```kconfig
if SHIELD_KOMMANDDECK || SHIELD_KOMMANDDECK_DONGLE

config ZMK_KEYBOARD_NAME
    default "Kommand Deck"

config ZMK_SPLIT
    default y

config ZMK_SPLIT_BLE
    default y

if SHIELD_KOMMANDDECK_DONGLE
config ZMK_SPLIT_ROLE_CENTRAL
    default y
endif

endif
```

## config/boards/shields/kommanddeck/Kconfig.shield
```kconfig
config SHIELD_KOMMANDDECK
    def_bool $(shields_list_contains,kommanddeck)

config SHIELD_KOMMANDDECK_DONGLE
    def_bool $(shields_list_contains,kommanddeck_dongle)
```
