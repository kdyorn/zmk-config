python3 << 'PYEOF'
content = '''#include <behaviors.dtsi>
#include <dt-bindings/zmk/keys.h>
#include <dt-bindings/zmk/bt.h>
#include <dt-bindings/zmk/matrix_transform.h>
#include "dissect.dtsi"

&default_transform {
    col-offset = <0>;
};

&kscan0 {
    col-gpios
        = <&gpio1 4  (GPIO_ACTIVE_HIGH)>
        , <&gpio1 6  (GPIO_ACTIVE_HIGH)>
        , <&gpio0 9  (GPIO_ACTIVE_HIGH)>
        , <&gpio0 10 (GPIO_ACTIVE_HIGH)>
        , <&gpio1 11 (GPIO_ACTIVE_HIGH)>
        , <&gpio1 13 (GPIO_ACTIVE_HIGH)>
        , <&gpio1 15 (GPIO_ACTIVE_HIGH)>
        ;
};
'''

with open('/home/kdyorn/zmk-config/config/boards/shields/dissect/dissect_left.overlay', 'w') as f:
    f.write(content)
print("Done!")
PYEOF