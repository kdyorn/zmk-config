## config/boards/shields/dissect/Kconfig.defconfig
```kconfig
if SHIELD_DISSECT_LEFT || SHIELD_DISSECT_RIGHT

config ZMK_KEYBOARD_NAME
    default "Dissect"

config ZMK_SPLIT
    default y

config ZMK_SPLIT_BLE
    default y

if SHIELD_DISSECT_LEFT
config ZMK_SPLIT_ROLE_CENTRAL
    default y
endif

endif
```

## config/boards/shields/dissect/Kconfig.shield
```kconfig
config SHIELD_DISSECT_LEFT
    def_bool $(shields_list_contains,dissect_left)

config SHIELD_DISSECT_RIGHT
    def_bool $(shields_list_contains,dissect_right)
```
